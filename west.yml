## west.yml
```yaml
manifest:
  remotes:
    - name: nrfconnect
      url-base: https://github.com/nrfconnect

  projects:
    - name: sdk-nrf
      repo-path: sdk-nrf
      path: nrf
      remote: nrfconnect
      revision: v3.4.0  # Pins workspace to the stable LTS version
      import: true

  self:
    path: docker_space
```
